/*
 * crc.hpp
 *
 * The STM32G0's CRC calculation unit (RM0444 ch. 14): one AHB peripheral
 * with five registers and no interrupt, no DMA request and no errata -
 * the smallest complete chapter in this stratum.
 *
 *  Crc     the RESOURCE, and there is no task above it: a checksum has
 *          no ordering rule of its own to hide. It is a MONOSTATE (the
 *          samc Dsc/Dac/Rtc precedent): every part of this family has
 *          exactly one, so an instance number would be a lie with a
 *          template parameter attached.
 *
 * FIVE FACTS THAT SHAPE THIS FILE.
 *
 * 1. THE DATA REGISTER IS THE ONLY ONE WITH NARROW ACCESSES. 14.4: "the
 *    CRC_DR register can be accessed by words, right-aligned half-words
 *    and right-aligned bytes. For the other registers only 32-bit
 *    accesses are allowed" - so feed(), feed16() and feed8() reach the
 *    SAME address through three differently-typed volatile pointers, and
 *    every other verb in this file is a word store.
 *
 * 2. WHAT A WRITE FEEDS DEPENDS ON REV_IN, AND SO THE BYTE ORDER OF A
 *    WORD IS A CALLER'S QUESTION. A 32-bit write is processed most
 *    significant BYTE first; REV_IN reverses bits by byte, by half-word
 *    or across the whole word before that happens (14.3.3's own
 *    0x1A2B3C4D example). So a byte STREAM fed as words is only the same
 *    computation as the same stream fed byte by byte when the assembly
 *    matches the reversal: BIG-ENDIAN assembly under REV_IN none or
 *    byte, little-endian assembly under REV_IN word. `feed(span)`
 *    assembles big-endian and FALLS BACK to byte-by-byte under the two
 *    reversals that cross a byte boundary, so the verb means one thing
 *    whatever is configured. test_stm32_crc letter b measures the
 *    equivalence in all four settings rather than asserting it.
 *
 * 3. THE POLYNOMIAL MAY NOT CHANGE MID-CALCULATION. 14.3.3: "if a CRC
 *    calculation is ongoing, the application must either reset it or
 *    perform a CRC_DR read before changing the polynomial" - so
 *    configure() ENDS with CR.RESET, which is also what makes a
 *    configuration a fresh start rather than a modifier of whatever was
 *    in DR. Writing CRC_INIT alone would do half of it: 14.3.3 says
 *    "the CRC_DR register is automatically initialized upon CRC_INIT
 *    register write access", which is one of the two things RESET does.
 *
 * 4. EVEN POLYNOMIALS DO NOT EXIST. 14.3.3 says so in four words and
 *    the silicon enforces nothing, so `crc_config_valid()` refuses a
 *    polynomial with bit 0 clear - and refuses one that does not fit
 *    the width it declares, which the register cannot notice either
 *    (14.4.5: "if the polynomial size is less than 32 bits, the least
 *    significant bits have to be used").
 *
 * 5. CRC_IDR IS NOT A CRC REGISTER. 14.4.2: four bytes of general
 *    storage "not affected by CRC resets generated by the RESET bit" -
 *    scratch() is offered because the chapter offers it, and it is the
 *    one register here whose value means nothing to this peripheral.
 *
 * ## util/crc.hpp is NOT replaced and NOT hooked
 *
 * util/crc.hpp's bitwise CRC-16/CCITT-FALSE is portable, constexpr and
 * the nonvolatile stores' judge on three architectures. This block
 * computes the same checksum with `crc_ccitt_false_config` - which is
 * what test_stm32_crc letter b proves bit for bit over 4 KB - but
 * nothing in util/ is pointed at it: a hardware hook for a util service
 * is a design question about the util level (a concept, a fallback, what
 * a constexpr context does with a peripheral), and it is not this
 * stratum's to open.
 *
 * ## Errata
 *
 * ES0548 Rev 3, read on the bench chip's revision Z column: NO ITEM
 * TOUCHES THE CRC. That is a statement about the document, not a claim
 * about the silicon.
 */

#pragma once

#include <stdint.h>

#include <span>

#include "stm32g0xx.h"

#include "stm32g0/clock.hpp"
#include "stm32g0/device_tables.hpp"
#include "util/wire.hpp"

namespace brio {

// =============================================================================
// Vocabulary
// =============================================================================

/// CRC_CR.POLYSIZE (14.4.3). The codes are the register's own, so the
/// enumerator's VALUE is what gets written - and the width in bits is a
/// separate question, answered by crc_width_bits().
enum class CrcWidth : uint8_t {
    w32 = 0,
    w16 = 1,
    w8 = 2,
    w7 = 3,
};

constexpr uint8_t crc_width_bits(CrcWidth w) {
    switch (w) {
        case CrcWidth::w32: return 32;
        case CrcWidth::w16: return 16;
        case CrcWidth::w8: return 8;
        case CrcWidth::w7: return 7;
    }
    return 32;
}

/// The mask of the bits a result of that width really occupies - 14.3.3:
/// "if the CRC data is less than 32-bit, its value can be read from the
/// least significant bits of the CRC_DR register", and the bits above it
/// hold whatever the wider datapath left there.
constexpr uint32_t crc_width_mask(CrcWidth w) {
    const uint8_t bits = crc_width_bits(w);
    return bits >= 32u ? 0xFFFFFFFFu
                       : static_cast<uint32_t>((1UL << bits) - 1UL);
}

/// CRC_CR.REV_IN (14.4.3): at which granularity the bit order of the
/// INPUT is reversed before the computation sees it.
enum class CrcReverse : uint8_t {
    none = 0,
    byte = 1,
    halfword = 2,
    word = 3,
};

/// Everything about the unit that is not a datum. The defaults ARE the
/// reset values (14.4.3, 14.4.4, 14.4.5), so a default-constructed
/// config re-establishes the CRC-32 (Ethernet) polynomial with no
/// reversal - which is not a standard CRC-32 by itself; see
/// `crc32_ieee_config` for the one that is.
struct CrcConfig {
    uint32_t polynomial = 0x04C11DB7u;   ///< CRC_POL
    CrcWidth size = CrcWidth::w32;       ///< CRC_CR.POLYSIZE
    uint32_t init = 0xFFFFFFFFu;         ///< CRC_INIT
    CrcReverse reverse_in = CrcReverse::none;   ///< CRC_CR.REV_IN
    bool reverse_out = false;                   ///< CRC_CR.REV_OUT
};

/**
 * The two rules of 14.3.3 that no register enforces:
 *
 *  - the polynomial is ODD ("even polynomials are not supported"; the
 *    chapter's own definition is that an odd one has the constant term,
 *    i.e. bit 0 set);
 *  - it fits the width it declares, since CRC_POL is a full word
 *    whatever POLYSIZE says and the bits above the width would simply
 *    be ignored - silently producing a checksum nobody asked for.
 *
 * The implicit X^n term is never written, on this silicon as on every
 * other: a 16-bit 0x1021 is the whole of CCITT's X^16+X^12+X^5+1.
 */
constexpr bool crc_config_valid(const CrcConfig& c) {
    if ((c.polynomial & 1u) == 0u) {
        return false;
    }
    return (c.polynomial & ~crc_width_mask(c.size)) == 0u;
}

// ---- the two named standards -------------------------------------------------

/// CRC-16/CCITT-FALSE: polynomial 0x1021, initial value 0xFFFF, no
/// reversal either way, no final XOR - byte for byte what
/// util/crc.hpp's `crc16()` computes in software. Feed it a byte
/// stream; "123456789" gives 0x29B1.
constexpr CrcConfig crc_ccitt_false_config{
    .polynomial = 0x1021u,
    .size = CrcWidth::w16,
    .init = 0xFFFFu,
    .reverse_in = CrcReverse::none,
    .reverse_out = false,
};

/// CRC-32/ISO-HDLC, the reflected CRC-32 of IEEE 802.3, zip and the
/// SAM's own DSU engine: polynomial 0x04C11DB7, initial value
/// 0xFFFFFFFF, input reflected per byte, output reflected - AND A FINAL
/// XOR THE HARDWARE DOES NOT DO, which is why `crc32_ieee_finish()`
/// exists beside it and why a caller that forgets it gets the
/// complement of the right answer. "123456789" finished gives
/// 0xCBF43926.
constexpr CrcConfig crc32_ieee_config{
    .polynomial = 0x04C11DB7u,
    .size = CrcWidth::w32,
    .init = 0xFFFFFFFFu,
    .reverse_in = CrcReverse::byte,
    .reverse_out = true,
};

/// The final XOR of the reflected CRC-32. One line, because it is one
/// operation the peripheral has no register for.
constexpr uint32_t crc32_ieee_finish(uint32_t v) { return v ^ 0xFFFFFFFFu; }

// =============================================================================
// The resource
// =============================================================================

/**
 * Crc: the calculation unit.
 *
 *   brio::Crc::init();
 *   brio::Crc::configure(brio::crc_ccitt_false_config);
 *   brio::Crc::feed(std::span{payload});
 *   const uint16_t sum = static_cast<uint16_t>(brio::Crc::value_masked());
 *
 * There is exactly one on every part of the family, so this is a
 * monostate and not a template.
 */
class Crc {
public:
    Crc() = delete;

    static_assert(crc_present(),
                  "brio Crc: this device header declares no CRC_BASE - every "
                  "STM32G0 of the pack has the unit, so this is a header the "
                  "stratum has not met");

    static CRC_TypeDef& regs() {
        return *reinterpret_cast<CRC_TypeDef*>(crc_base());
    }

    // ---- the bus clock and the reset ----------------------------------------
    //
    // 5.2.17: a peripheral whose enable bit is clear does not answer
    // register reads at all, so init() opens the gate before touching
    // anything. The readback after the store is the two-cycle stall the
    // chapter asks software to account for - Rcc::ahb_clock() pays it.

    static void bus_clock(bool on) { Rcc::ahb_clock(crc_clock_mask(), on); }
    static bool bus_clock() { return (RCC->AHBENR & crc_clock_mask()) != 0u; }

    /// Pulse RCC_AHBRSTR: every register back to the value 14.4.6
    /// prints. Written here rather than through an Rcc verb for the same
    /// reason stm32g0/dma.hpp writes its own - the AHB reset register has
    /// exactly two users in this stratum and neither needs a shared one.
    static void reset() {
        RCC->AHBRSTR = RCC->AHBRSTR | crc_reset_mask();
        (void)RCC->AHBRSTR;
        RCC->AHBRSTR = RCC->AHBRSTR & ~crc_reset_mask();
        (void)RCC->AHBRSTR;
    }

    /// Clock on, then reset: the whole of "bring the CRC up".
    static void init() {
        bus_clock(true);
        reset();
    }

    /// Block reset and its clock closed. Nothing else is claimed - the
    /// CRC has no pad, no interrupt and no request line.
    static void release() {
        reset();
        bus_clock(false);
    }

    // ---- configuration (14.3.3, 14.4.3..14.4.5) -----------------------------

    /**
     * Write the whole configuration and START A FRESH CALCULATION.
     *
     * Refused (false, nothing written) for a configuration
     * `crc_config_valid()` rejects - an even polynomial, or one wider
     * than the size it declares.
     *
     * The ORDER is 14.3.3's rule read forwards: the unit is reset FIRST,
     * so no calculation is ongoing when the polynomial changes; then
     * CR (which carries POLYSIZE and both reversals), then POL, then
     * INIT - whose write initializes CRC_DR on its own - and a final
     * RESET so the datapath starts from INIT whatever the intervening
     * stores did. Two resets is one more than the minimum and costs two
     * AHB writes; getting the rule wrong costs a wrong checksum that
     * looks like a bug in the caller.
     */
    static bool configure(const CrcConfig& c) {
        if (!crc_config_valid(c)) {
            return false;
        }
        CRC_TypeDef& r = regs();
        r.CR = CRC_CR_RESET;
        r.CR = (static_cast<uint32_t>(c.size) << CRC_CR_POLYSIZE_Pos) |
               (static_cast<uint32_t>(c.reverse_in) << CRC_CR_REV_IN_Pos) |
               (c.reverse_out ? CRC_CR_REV_OUT : 0u);
        r.POL = c.polynomial;
        r.INIT = c.init;
        r.CR = r.CR | CRC_CR_RESET;
        width_ = c.size;
        return true;
    }

    /// CR.RESET alone: DR back to INIT, everything else left standing.
    /// The verb between two independent checksums under one
    /// configuration.
    static void restart() { regs().CR = regs().CR | CRC_CR_RESET; }

    /// What POLYSIZE holds right now, read off the silicon - the width
    /// `value_masked()` uses when nothing has configured this unit
    /// through configure() (after a plain reset, 32 bits).
    static CrcWidth width() {
        return static_cast<CrcWidth>((regs().CR & CRC_CR_POLYSIZE_Msk) >>
                                     CRC_CR_POLYSIZE_Pos);
    }
    static CrcReverse reverse_in() {
        return static_cast<CrcReverse>((regs().CR & CRC_CR_REV_IN_Msk) >>
                                       CRC_CR_REV_IN_Pos);
    }
    static bool reverse_out() { return (regs().CR & CRC_CR_REV_OUT) != 0u; }
    static uint32_t polynomial() { return regs().POL; }
    static uint32_t initial() { return regs().INIT; }

    // ---- feeding (14.3.3) ---------------------------------------------------
    //
    // Three access widths through ONE address. The narrow ones are
    // spelled through differently-typed volatile pointers because that
    // is what makes the compiler emit STRH and STRB rather than a word
    // store of a widened value - the register cannot tell a byte write
    // from a word write of the same number by its data, only by the
    // access size.

    /// One 32-bit datum: 4 HCLK cycles of computation, hidden behind the
    /// input buffer (14.2) so a second write does not stall.
    static void feed(uint32_t v) { regs().DR = v; }

    /// One right-aligned half-word: 2 HCLK cycles. The address is
    /// formed from the block's BASE rather than by taking &DR and
    /// re-typing it: CRC_DR is at offset 0x00 (14.4.1), and an
    /// integer-to-pointer cast is what keeps this out of the
    /// strict-aliasing rule a type-punned `&regs().DR` would break.
    static void feed16(uint16_t v) {
        *reinterpret_cast<volatile uint16_t*>(crc_base()) = v;
    }

    /// One right-aligned byte: 1 HCLK cycle. Same address, same reason.
    static void feed8(uint8_t v) {
        *reinterpret_cast<volatile uint8_t*>(crc_base()) = v;
    }

    /**
     * A BYTE STREAM, in stream order - the verb a checksum over a buffer
     * actually wants.
     *
     * 14.3.3's own advice is to "dynamically adjust the data size to
     * minimize the number of write accesses", so this feeds words while
     * four bytes remain and the tail as bytes. THE WORDS ARE ASSEMBLED
     * BIG-ENDIAN, because a 32-bit write is processed most significant
     * byte first: that is what makes the word path compute the same
     * thing as the byte path.
     *
     * Under REV_IN halfword or word the reversal crosses byte
     * boundaries, so no assembly makes the two paths agree and this verb
     * FEEDS BYTE BY BYTE instead. The branch is one read of CR. Fact 2
     * of the file header; letter b of the suite measures all four
     * settings rather than trusting this comment.
     */
    static void feed(std::span<const uint8_t> data) {
        const CrcReverse rev = reverse_in();
        if (rev == CrcReverse::halfword || rev == CrcReverse::word) {
            for (uint8_t b : data) {
                feed8(b);
            }
            return;
        }
        size_t i = 0;
        for (; i + 4u <= data.size(); i += 4u) {
            feed(load_be32(data.data() + i));
        }
        for (; i < data.size(); ++i) {
            feed8(data[i]);
        }
    }

    /// A run of 32-bit data as data (not as a byte stream): every word
    /// written whole, the caller owning what its byte order means.
    static void feed(std::span<const uint32_t> data) {
        for (uint32_t w : data) {
            feed(w);
        }
    }

    // ---- reading ------------------------------------------------------------

    /// CRC_DR, whole. For a width under 32 the bits above it are the
    /// datapath's leftovers - use value_masked() unless you want to see
    /// them (letter a does).
    static uint32_t value() { return regs().DR; }

    /// The result of the configured width, 14.3.3's "least significant
    /// bits". The width comes from the last configure(); a unit
    /// configured behind this driver's back is read with width_now().
    static uint32_t value_masked() { return regs().DR & crc_width_mask(width_); }

    /// The same, with the width read off POLYSIZE instead of remembered.
    static uint32_t value_masked_now() { return regs().DR & crc_width_mask(width()); }

    /// The address a DMA channel writes to feed this unit: CRC_DR.
    ///
    /// The channel is a MEMORY-TO-MEMORY one (stm32g0/dma.hpp,
    /// `memory_to_memory = true`), because the CRC publishes no request
    /// line of its own on this family - table 55 has no CRC row - so
    /// nothing would ever ask for a beat. The source increments and the
    /// DESTINATION DOES NOT: this address is fixed, which in DMA terms
    /// means MINC on the source side only. Both widths are the caller's:
    /// a word-wide channel feeds words (fact 2's byte-order question is
    /// then the caller's), a byte-wide one feeds bytes.
    static volatile void* data_address() { return &regs().DR; }

    // ---- the scratch register (14.4.2) --------------------------------------

    /// CRC_IDR: four bytes of storage this peripheral never looks at,
    /// and NOT AFFECTED BY CR.RESET - which is the only interesting
    /// thing about it and what letter a checks.
    static void scratch(uint32_t v) { regs().IDR = v; }
    static uint32_t scratch() { return regs().IDR; }

private:
    /// The width the last configure() asked for. A remembered value and
    /// not a register read, so value_masked() costs one AND; POLYSIZE is
    /// still the truth and width() reads it.
    static inline CrcWidth width_ = CrcWidth::w32;
};

} // namespace brio
